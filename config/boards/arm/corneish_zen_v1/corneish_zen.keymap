/*
*
* Copyright (c) 2021 Darryl deHaan
* SPDX-License-Identifier: MIT
*
*/

#include <behaviors.dtsi>
#include <dt-bindings/zmk/keys.h>
#include <dt-bindings/zmk/bt.h>

/ {
  chosen {
    zmk,matrix_transform = &default_transform;
    //zmk,matrix_transform = &five_column_transform;
  };
};

#include "../../../moutis_config.h"

/ {
#include "../../../moutis_behaviors.dtsi"
#include "../../../moutis_macros.dtsi"
#include "../../../moutis_combos.dtsi"

        keymap {
        compatible = "zmk,keymap";
#include "corneish_zen.l_alpha-HD-vv.dtsi"  // base (alpha) layer (& related adaptive layers)
#include "corneish_zen.l_layers.dtsi"  // all other (common) layers (shouldn't vary)

    };
};
