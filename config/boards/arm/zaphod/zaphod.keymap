/*
 *
 * Copyright (c) 2022 Alan Reiser
 * SPDX-License-Identifier: MIT
 */

#include <behaviors.dtsi>
#include <dt-bindings/zmk/keys.h>
#include <dt-bindings/zmk/bt.h>

#include "keynames_3x5_2.h"     // key name defs for this board topology
#include "moutis_config.dtsi"   // my add-on feature defs
#include "handsdown/vf-config.h"  // HD alpha & related ak_layer definitions

/ {
#include "moutis_behaviors.dtsi"
#include "moutis_macros.dtsi"

    combos {
        compatible = "zmk,combos";
        
#include "moutis_combos-common.dtsi" // common/location based combos (cut/copy/paste, esc, app, etc.)
#include HD_combo_file               // HDalpha/mnemonic based combos (h-digraphs, etc.)
    };
    
    keymap {
        compatible = "zmk,keymap";

#include "moutis_3x5_2.dtsi"    // base (alpha) layer (& related adaptive layers)
#include "moutis_layers.dtsi"   // all other (common) layers (shouldn't vary)
    };
};
