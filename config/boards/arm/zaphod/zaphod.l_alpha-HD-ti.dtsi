            /*           Base (alpha) Layer  (Hands Down Titanium)
            Building for a 36 key on a 42 key board (outside column is unused)
                   ╭─────────────────╮ ╭─────────────────╮
                   │  X  G  M  P  J  │ │ #$  .: /* "[ '] │
                   │  C  S  N  T  K  | | ,;   A  E  I  H │
                   │  W  F  L  D  V  │ │ -+   U  O  Y  B │
                   ╰───────╮  BSP R  │ │ SPC RET  ╭──────╯
                           ╰─────────╯ ╰──────────╯   */

                default_layer {
                        label = "HD-ti";
                        bindings = <

//   &none &none &none &none &none &none   &none &none &none &none &none &none
//   &none &none &none &none &none &none   &none &none &none &none &none &none
//   &none &none &none &none &none &none   &none &none &none &none &none &none
//                     &none &none &none   &none &none &none

&kp X       &kp G &kp M     &kp P      &kp J                   &HashDllr  &DotColn    &SlshStar   &DqtLbkt   &SqtRbkt
&hm LCTRL C &hm LALT S      &hm LGUI N  &hm LSHFT T &lt l_num K &CmmaSemi  &hm RSHFT A &hm RGUI E  &hm RALT I  &hm RCTRL H
&kp W       &kp F &kp L     &kp D       &kp V                   &MinusPlus  &kp U      &kp O       &kp Y       &kp B


                &lt l_fn BACKSPACE &lt l_nav R      &lt l_sym SPACE &lt l_nav RETURN
                        >;
                };

