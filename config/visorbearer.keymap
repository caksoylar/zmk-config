#include "keypos_def/keypos_26keys.h"

/ {
    chosen {
        zmk,physical-layout = &visorbearer_13332_2u_layout;
    };
};

#include <behaviors.dtsi>
#include <dt-bindings/zmk/bt.h>
#include <behaviors/led_bars.dtsi>

#include "includes/3x5.dtsi"

/ {
    combos {
        combo_sftoff { timeout-ms = <100>; bindings = <&soft_off>; key-positions = <12 13>; layers = <FUN>; require-prior-idle-ms = <500>; };
    };
};
