/*
 *
 * Copyright (c) 2022 The ZMK Contributors
 * SPDX-License-Identifier: MIT
 */

/*    KEY POSITION Numbers for 3x5+3
 ╭────────────────────╮ ╭────────────────────╮
 │  0   1   2   3   4 │ │  5   6   7   8   9 │
 │ 10  11  12  13  14 │ │ 15  16  17  18  19 |
 | 20  21  22  23  24 │ │ 25  26  27  28  29 |
 ╰───────╮ 30  31  32 | | 33  34 35 ╭────────╯
         ╰────────────╯ ╰───────────╯
*/
/*    KEY POSITION Names
╭─────────────────────╮ ╭─────────────────────╮
│ LT4 LT3 LT2 LT1 LT0 │ │ RT0 RT1 RT2 RT3 RT4 │
│ LM4 LM3 LM2 LM1 LM0 │ │ RM0 RM1 RM2 RM3 RM4 │
│ LB4 LB3 LB2 LB1 LB0 │ │ RB0 RB1 RB2 RB3 RB4 │
╰───────╮ LH3 LH2 LH1 | | RH1 RH2 RH3 ╭───────╯
        ╰─────────────╯ ╰─────────────╯
*/
#include <behaviors.dtsi>
#include <dt-bindings/zmk/keys.h>
#include <dt-bindings/zmk/bt.h>

#include "HD-3x5+3.h" // key name defs for this board
#include "moutis_config.dtsi" // my add-on feature defs

/ {
#include "moutis_behaviors.dtsi"
#include "moutis_macros.dtsi"

    combos {
        compatible = "zmk,combos";

#include "moutis_combos-common.dtsi"
#include "moutis_combos-vf.dtsi"

    };

    keymap {
        compatible = "zmk,keymap";

#include "boards/shields/bad_wings_slim/bad_wings_slim.l_alpha-HD-vf.dtsi"  // base (alpha) layer (& related adaptive layers)
#include "boards/shields/bad_wings_slim/bad_wings_slim.l_layers.dtsi"  // all other (common) layers (shouldn't vary)

    };
};
