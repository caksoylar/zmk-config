//
//  moutis_config.dtsi
//  
//
//  Created by Alan on 7/24/22.
//


//
// which HD alpha variation are we using?
//
//
// nu = neu (no thumb alpha)    * does not use thumb
// au = gold (T on thumb)       * most inward rolling
// ag = silver (L on thumb)       * LOW sfbs, but high repeat on thumb
// bz = bronze (H on thumb)     * lightest thumb use w/H-digraph combos
// cr = chromium (C on thumb)   * RSNT typically doesn't use H-digraph combos
// cs = cesium (C on thumb)     * lowest scissors, – lowest thumb w/o H-digraph combos
// pm = promethium (R on thumb) * typically doesn't use H-digraph combos
// rh = rhodium (R on thumb)    * typically doesn't use H-digraph combos
// vf = vibranium (R on thumb, f in lower left, b on right) - "canonical"
// vv = vibranium (R on thumb, v in lower left, f on right) - lowest SFBs
// vx = vibranium (R on thumb, x in lower left, f on right) - better pinky balancing
// vb = vibranium (R on thumb, b in lower left, f on right) - more rolling w/adaptives
// mi = mithril (R on thumb)
// xr = weird test-bed (R on thumb)



#define H_DIGRAPH_COMBOS //  (th, ch, sh, wh, gh, ph)
#define EN_PRONOUN_COMBOS //  (I, I'm, I've I'd I'll etc)
#define COMMA_CAP     // , before alpha capitalizes that alpha

#define my_ak_term 350 // behavior-adaptive-key trigger time window
#define my_ak_delay 50

#define my_tapping_term 200
#define my_quick_tapping_term 55

// my layers
#define l_any   -1
#define l_alpha 0 // main HD alpha layer
#define l_japan  1 // alternate Japanese base layer (XCL="-Zん", no adaptives)
#define l_akDot  2 // funky holdover ak layer (used for comma cap)
#define l_sym    3 // 2 - symbols, punctuation, off-map alphas
#define l_num    4 // 3 - function & number rows
#define l_fun    5 // 4 - numpad (right); navpad (left)
#define l_nav    6 // 5 - nav pad (right); meta keys (left)
#define l_cfg    7 // 6 - Media/Consumer controls; Keyboard settings

&mt {
    tapping-term-ms = <my_tapping_term>;
};
&sl {
    release-after-ms = <my_tapping_term>;
};
&caps_word {
    continue-list = <UNDER MINUS BSPC DEL LEFT RIGHT>;
};
