/*  Abstracted base (alpha) layers & associated adaptive key layers on a 36 key board
    The values here are all defined in the corresponding HD-##.h file
*/

            l_alpha {
                label = HD_Layer_label;
                bindings = <
                                HD_Ltop         HD_Rtop
                                HD_Lmid         HD_Rmid
                                HD_Lbtm         HD_Rbtm
                     &AppSwitch HD_Lthm         HD_Rthm  &tog l_num
                        >;
                    };
            l_jp {
                label = JP_Layer_label; // Japanese "mode" (L, C, X not used in Japanese, so repurpose to ん, Z, -)
                bindings = <
                                JP_Ltop         JP_Rtop
                                JP_Lmid         JP_Rmid
                                JP_Lbtm         JP_Rbtm
                        _______ JP_Lthm         JP_Rthm  _______
                >;
            };
            l_akDOT {
                label = l_akDOT_label;
                bindings = <
                                DOT_Ltop       DOT_Rtop
                                DOT_Lmid       DOT_Rmid
                                DOT_Lbtm       DOT_Rbtm
                        _______ DOT_Lthm       DOT_Rthm  _______
                >;
            };
