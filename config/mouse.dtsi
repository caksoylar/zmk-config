#include <dt-bindings/zmk/mouse.h>

&mmv {
    acceleration-exponent = <1>;      // 1
    time-to-max-speed-ms = <500>;     // 300
    delay-ms = <0>;                   // 0
};

&mwh {
    acceleration-exponent = <1>;      // 0
    time-to-max-speed-ms = <40>;      // 300
    delay-ms = <0>;                   // 0
};

#define U_MOUSE_MOVE_MAX 1500       // 600
#define U_MOUSE_SCROLL_MAX 20       // 10

#define M_UP MOVE_VERT(-U_MOUSE_MOVE_MAX)
#define M_DOWN MOVE_VERT(U_MOUSE_MOVE_MAX)
#define M_LEFT MOVE_HOR(-U_MOUSE_MOVE_MAX)
#define M_RIGHT MOVE_HOR(U_MOUSE_MOVE_MAX)

#define S_UP SCROLL_VERT(U_MOUSE_SCROLL_MAX)
#define S_DOWN SCROLL_VERT(-U_MOUSE_SCROLL_MAX)
#define S_LEFT SCROLL_HOR(-U_MOUSE_SCROLL_MAX)
#define S_RIGHT SCROLL_HOR(U_MOUSE_SCROLL_MAX)
