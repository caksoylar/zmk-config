/*
 *
 * Copyright (c) 2022 The ZMK Contributors
 * SPDX-License-Identifier: MIT
 */

#include <behaviors.dtsi>
#include <dt-bindings/zmk/keys.h>
#include <dt-bindings/zmk/bt.h>

#include "keynames_3x5_3.h"         // key name defs for this board topology
#include "moutis_config.dtsi"       // my add-on feature defs
#include "handsdown/vf-config.h"    // HD alpha & related ak_layer definitions

/ {
#include "moutis_behaviors.dtsi"    // includes modtaps, modmorphs, lingers, adaptives
#include "moutis_macros.dtsi"

    combos {
        compatible = "zmk,combos";
        
#include "moutis_combos.dtsi"       // common/location based combos (cut/copy/paste, esc, app, etc.)
#include HD_combo_file              // HDalpha/mnemonic based combos (h-digraphs, etc.)
    };
    
    keymap {
        compatible = "zmk,keymap";

#include "alpha_3x5_3.dtsi"    // base (alpha) layer (& related adaptive layers)
#include "layers_3x5_3.dtsi"   // all other (common) layers (shouldn't vary)
    };

};
