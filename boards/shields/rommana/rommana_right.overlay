#include "rommana.dtsi"

&default_transform {
    col-offset = <5>;
};

&kscan0 {
    row-gpios
        = <&xiao_d 1 (GPIO_PULL_DOWN | GPIO_ACTIVE_HIGH)>
        , <&xiao_d 0 (GPIO_PULL_DOWN | GPIO_ACTIVE_HIGH)>
        , <&xiao_d 2 (GPIO_PULL_DOWN | GPIO_ACTIVE_HIGH)>
        ;

    col-gpios
        = <&xiao_d  3 GPIO_ACTIVE_HIGH>
        , <&xiao_d  8 GPIO_ACTIVE_HIGH>
        , <&xiao_d  9 GPIO_ACTIVE_HIGH>
        , <&xiao_d 10 GPIO_ACTIVE_HIGH>
        , <&xiao_d  7 GPIO_ACTIVE_HIGH>
        ;
};

&bootloader_key_right {
    status = "okay";
};
