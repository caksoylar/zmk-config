## config/boards/arm/corneish_zen/west.yml
```yaml
manifest:
  remotes:
    - name: caksoylar
      url-base: https://github.com/caksoylar

  projects:
    - name: zmk
      remote: caksoylar
      revision: caksoylar/zen-v1+v2  # custom branch name
      import: app/west.yml
  self:
    path: config
```

## config/boards/arm/zaphod/Kconfig
```kconfig
# SPDX-License-Identifier: MIT

config BOARD_ENABLE_DCDC
	bool "Enable DCDC mode"
	select SOC_DCDC_NRF52X
	default y
	depends on BOARD_ZAPHOD

if ZMK_DISPLAY

menuconfig ZAPHOD_BONGO_CAT
    bool "Show WPM bongo cat"
    select ZMK_WPM
    select LV_USE_IMG
    select LV_USE_ANIMATION

if ZAPHOD_BONGO_CAT

config ZAPHOD_BONGO_CAT_IDLE_LIMIT
    int "Upper limit for WPM for showing idle animation"
    default 30

config ZAPHOD_BONGO_CAT_SLOW_LIMIT
    int "Upper limit for WPM for showing slow typing image"
    default 60

endif # ZAPHOD_BONGO_CAT


endif
```

## config/boards/arm/zaphod/Kconfig.board
```kconfig
# Zaphod board configuration

# Copyright (c) 2020 Pete Johanson
# SPDX-License-Identifier: MIT

config BOARD_ZAPHOD
	bool "Zaphod"
	depends on SOC_NRF52840_QIAA
```

## config/boards/arm/zaphod/Kconfig.defconfig
```kconfig
# Copyright (c) 2020 Pete Johanson
# SPDX-License-Identifier: MIT

if BOARD_ZAPHOD

config BOARD
	default "zaphod"

config ZMK_KEYBOARD_NAME
	default "Zaphod"

if USB

config USB_NRFX
	default y

config USB_DEVICE_STACK
	default y

endif # USB

config ZMK_DISPLAY
	select LV_USE_CONT
	select LV_FONT_MONTSERRAT_26

choice ZMK_DISPLAY_STATUS_SCREEN
	default ZMK_DISPLAY_STATUS_SCREEN_CUSTOM


endchoice

config ZMK_DISPLAY_STATUS_SCREEN_CUSTOM
	select LV_USE_LABEL

if ZMK_DISPLAY

config LV_Z_MEM_POOL_SIZE
     default 4096

choice LV_FONT_DEFAULT
    default LV_FONT_DEFAULT_MONTSERRAT_26

endchoice

choice ZMK_LV_FONT_DEFAULT_SMALL
    default ZMK_LV_FONT_DEFAULT_SMALL_MONTSERRAT_26

endchoice

config SPI
	default y

config LS0XX
	default y

config LV_Z_BITS_PER_PIXEL
	default 1

choice LV_COLOR_DEPTH
	default LV_COLOR_DEPTH_1

endchoice

config LV_DPI_DEF
	default 30

config LV_Z_VDB_SIZE
	default 16

endif # ZMK_DISPLAY

config BT_CTLR
	default BT

config ZMK_BLE
	default y

config ZMK_USB
	default y

config ZMK_BATTERY_VOLTAGE_DIVIDER
	default y

endif # BOARD_ZAPHOD
```

## config/boards/arm/zaphod/zaphod_defconfig
```kconfig
# SPDX-License-Identifier: MIT

CONFIG_SOC_SERIES_NRF52X=y
CONFIG_SOC_NRF52840_QIAA=y
CONFIG_BOARD_ZAPHOD=y

# Enable MPU
CONFIG_ARM_MPU=y

# enable GPIO
CONFIG_GPIO=y

CONFIG_ZMK_SLEEP=y

CONFIG_ZMK_DISPLAY=y
CONFIG_LV_USE_THEME_MONO=y
CONFIG_LV_COLOR_CHROMA_KEY_HEX=0x00FF00

CONFIG_USE_DT_CODE_PARTITION=y
CONFIG_BUILD_OUTPUT_UF2=y

CONFIG_MPU_ALLOW_FLASH_WRITE=y
CONFIG_NVS=y
CONFIG_SETTINGS_NVS=y
CONFIG_FLASH=y
CONFIG_FLASH_PAGE_LAYOUT=y
CONFIG_FLASH_MAP=y
```

## config/boards/shields/bad_wings_slim/Kconfig.shield
```kconfig
# Copyright (c) 2022 The ZMK Contributors
# SPDX-License-Identifier: MIT

config SHIELD_BAD_WINGS_SLIM
    def_bool $(shields_list_contains,bad_wings_slim)
```

## config/boards/shields/choc_ergo/Kconfig.defconfig
```kconfig
# Copyright (c) 2021 The ZMK Contributors
# SPDX-License-Identifier: MIT

if SHIELD_CHOC_ERGO_LEFT

config ZMK_KEYBOARD_NAME
	default "HexyChoc"

config ZMK_SPLIT_ROLE_CENTRAL
	default y

endif

if SHIELD_CHOC_ERGO_LEFT || SHIELD_CHOC_ERGO_RIGHT

config ZMK_SPLIT
	default y

endif
```

## config/boards/shields/choc_ergo/Kconfig.shield
```kconfig
# Copyright (c) 2021 The ZMK Contributors
# SPDX-License-Identifier: MIT

config SHIELD_CHOC_ERGO_LEFT
	def_bool $(shields_list_contains,choc_ergo_left)

config SHIELD_CHOC_ERGO_RIGHT
	def_bool $(shields_list_contains,choc_ergo_right)
```

## config/boards/shields/dust/Kconfig.defconfig
```kconfig
# Copyright (c) 2022 The ZMK Contributors
# SPDX-License-Identifier: MIT

if SHIELD_DUST_LEFT

config ZMK_KEYBOARD_NAME
    default "dust"

config ZMK_SPLIT_ROLE_CENTRAL
    default y

endif

if SHIELD_DUST_LEFT || SHIELD_DUST_RIGHT
config ZMK_SPLIT
    default y
endif
```

## config/boards/shields/dust/Kconfig.shield
```kconfig
# Copyright (c) 2022 The ZMK Contributors
# SPDX-License-Identifier: MIT

config SHIELD_DUST_LEFT
    def_bool $(shields_list_contains,dust_left)

config SHIELD_DUST_RIGHT
    def_bool $(shields_list_contains,dust_right)
```

## config/boards/shields/ffkb/Kconfig.shield
```kconfig
# Copyright (c) 2021 The ZMK Contributors
# SPDX-License-Identifier: MIT

config SHIELD_FFKB
    def_bool $(shields_list_contains,ffkb)
```

## config/boards/shields/hypergolic/Kconfig.defconfig
```kconfig
# Copyright (c) 2021 The ZMK Contributors
# SPDX-License-Identifier: MIT

if SHIELD_HYPERGOLIC_LEFT

config ZMK_KEYBOARD_NAME
	default "Hypergolic"

config ZMK_SPLIT_ROLE_CENTRAL
	default y

endif

if SHIELD_HYPERGOLIC_LEFT || SHIELD_HYPERGOLIC_RIGHT

config ZMK_SPLIT
	default y

endif
```

## config/boards/shields/hypergolic/Kconfig.shield
```kconfig
# Copyright (c) 2021 The ZMK Contributors
# SPDX-License-Identifier: MIT

config SHIELD_HYPERGOLIC_LEFT
	def_bool $(shields_list_contains,hypergolic_left)

config SHIELD_HYPERGOLIC_RIGHT
	def_bool $(shields_list_contains,hypergolic_right)
```

## config/boards/shields/klor/Kconfig.shield
```kconfig
config SHIELD_KLOR_LEFT
    def_bool $(shields_list_contains,klor_left)

config SHIELD_KLOR_RIGHT
    def_bool $(shields_list_contains,klor_right)
```

## config/boards/shields/klotz/Kconfig.defconfig
```kconfig
if SHIELD_KLOTZ_LEFT

    config ZMK_KEYBOARD_NAME
        default "KLOTZ"

    config ZMK_SPLIT_BLE_ROLE_CENTRAL
        default y

endif # LEFT



if SHIELD_KLOTZ_LEFT || SHIELD_KLOTZ_RIGHT

    config ZMK_SPLIT
        default y

endif # LEFT RIGHT



if ZMK_BACKLIGHT

    config PWM
        default y

    config LED_PWM
        default y

endif # ZMK_BACKLIGHT
```

## config/boards/shields/klotz/Kconfig.shield
```kconfig
config SHIELD_KLOTZ_LEFT
    def_bool $(shields_list_contains,klotz_left)

config SHIELD_KLOTZ_RIGHT
    def_bool $(shields_list_contains,klotz_right)
```

## config/boards/shields/rommana/Kconfig.defconfig
```kconfig
if SHIELD_ROMMANA_LEFT

config ZMK_KEYBOARD_NAME
    default "Rommana"

config ZMK_SPLIT_ROLE_CENTRAL
    default y

endif

if SHIELD_ROMMANA_LEFT || SHIELD_ROMMANA_RIGHT

config ZMK_SPLIT
    default y

endif
```

## config/boards/shields/rommana/Kconfig.shield
```kconfig
config SHIELD_ROMMANA_LEFT
    def_bool $(shields_list_contains,rommana_left)

config SHIELD_ROMMANA_RIGHT
    def_bool $(shields_list_contains,rommana_right)
```

## config/boards/shields/swweeep/Kconfig.defconfig
```kconfig
# Copyright (c) 2022 The ZMK Contributors
# SPDX-License-Identifier: MIT

if SHIELD_SWWEEEP_LEFT

config ZMK_KEYBOARD_NAME
	default "Swweeep"

config ZMK_SPLIT_ROLE_CENTRAL
	default y

endif

if SHIELD_SWWEEEP_LEFT || SHIELD_SWWEEEP_RIGHT

config ZMK_SPLIT
	default y

endif
```

## config/boards/shields/swweeep/Kconfig.shield
```kconfig
# Copyright (c) 2022 The ZMK Contributors
# SPDX-License-Identifier: MIT

config SHIELD_SWWEEEP_LEFT
    def_bool $(shields_list_contains,swweeep_left)

config SHIELD_SWWEEEP_RIGHT
    def_bool $(shields_list_contains,swweeep_right)
```

## config/west.yml
```yaml
manifest:
  remotes:
    - name: zmkfirmware
      url-base: https://github.com/zmkfirmware
    - name: caksoylar
      url-base: https://github.com/caksoylar
  projects:
    - name: zmk
      remote: zmkfirmware
      revision: v0.3
      import: app/west.yml
    - name: zmk-rgbled-widget
      remote: caksoylar
      revision: v0.3
    - name: zmk-smart-toggle
      remote: caksoylar
      revision: v0.3
    - name: visorbearer-zmk-module
      url: https://github.com/carrefinho/visorbearer-zmk-module
      revision: zmk-v0.3
    - name: zmk-keyboards-adept
      remote: caksoylar
      revision: v0.3
      import: config/deps.yml
  self:
    path: config
```
