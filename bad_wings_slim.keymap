/*
 * Copyright (c) 2022 The ZMK Contributors
 *
 * SPDX-License-Identifier: MIT
 */

#include <behaviors.dtsi>
#include <dt-bindings/zmk/keys.h>
#include <dt-bindings/zmk/bt.h>
#include <dt-bindings/zmk/outputs.h>


#include "boards/shields/bad_wings_slim/bad_wings_slim_config.h" // key name defs for this board
#include "moutis_config.h" // my add-on feature defs

/ {
#include "moutis_behaviors.dtsi"
#include "moutis_macros.dtsi"
#include "moutis_combos-vx.dtsi"

    keymap {
        compatible = "zmk,keymap";
#include "bad_wings_slim.l_alpha-HD-vx.dtsi"  // base (alpha) layer (& related adaptive layers)
#include "bad_wings_slim.l_layers.dtsi"  // all other (common) layers (shouldn't vary)

    };
};
